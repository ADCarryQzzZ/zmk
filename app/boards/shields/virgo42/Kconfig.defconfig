## app/boards/shields/virgo42/Kconfig.defconfig
```kconfig
# Copyright (c) 2020 The ZMK Contributors
# SPDX-License-Identifier: MIT

if SHIELD_VIRGO42ZMK

config ZMK_KEYBOARD_NAME
	default "virgo42_zmk"

endif
```

## app/boards/shields/virgo42/Kconfig.shield
```kconfig
# Copyright (c) 2020 The ZMK Contributors
# SPDX-License-Identifier: MIT

config SHIELD_VIRGO42ZMK
	def_bool $(shields_list_contains,virgo42zmk)
```
